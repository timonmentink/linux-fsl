/*
 * Copyright (C) 2015 Garz & Fricke GmbH
 *
 * This program is free software; you can redistribute it and/or modify
 * it under the terms of the GNU General Public License version 2 as
 * published by the Free Software Foundation.
 */

/dts-v1/;

#include "imx6q-guf.dtsi"
#include "imx6qdl-guf-santoka.dtsi"

/ {
	model = "SANTOKA";
	compatible = "guf,imx6q-santoka", "fsl,imx6q";
};
